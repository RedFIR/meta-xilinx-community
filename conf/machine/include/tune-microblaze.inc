## conf/machine/include/tune-microblaze.inc
```bitbake
TARGET_FPU ?= "soft"
TARGET_CC_ARCH = "-mcpu=v8.10.a"
BASE_PACKAGE_ARCH = "microblaze"
FEED_ARCH = "microblaze"
```

## conf/machine/microblaze-gen.conf
```bitbake
# Copyright (C) 2010, Adrian Alonso <aalonso00@gmail.com>
# Released under the MIT license (see packages/COPYING)
#@TYPE: Machine
#@Name: Xilinx generic microblaze target support
#@DESCRIPTION: Machine configuration for Xilinx Microblaze generic machine
# Supported targets: spartan3dsp, spartan3a1800, spartan6,
# virtex4, virtex5, virtex6
#
# Xilinx EDK override hardware  definitions for xilinx-bsp
# Include in your local.conf
# XILINX_BSP_PATH = "complete path for Xilinx XPS project"

TARGET_ARCH = "microblaze"
TARGET_CPU = "microblaze"
TARGET_FPU = "soft"
# tune for the microblaze cpu
require conf/machine/include/tune-microblaze.inc

PREFERRED_PROVIDER_virtual/kernel = "linux-xilinx"
PREFERRED_VERSION_u-boot_microblaze = "uboot-xilinx"
# Add uboot to rootfs
EXTRA_IMAGEDEPENDS += "u-boot-xilinx"

KERNEL_IMAGETYPE = "uImage"

MACHINE_FEATURES = "kernel26 apm ext2 vfat ethernet"
MACHINE_EXTRA_RECOMMENDS = "kernel-modules"

UBOOT_ENTRYPOINT ?= "0x00000000"
UBOOT_LOADADDRESS ?= "0x00000000"

# Don't use tty1
USE_VT = "0"
SERIAL_CONSOLE = "9600 ttyUL0"

# Device nodes add xsa for (system ace)
IMAGE_DEVICE_TABLES = "files/device_table-minimal.txt \
                       files/device_table_add-xsa.txt"
```
